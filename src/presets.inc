/*
 * presets.cpp — 16 种音色预设
 * 由四个开关 (SW1~SW4) 选择 0~15
 */

#include <Arduino.h>
#include "src/config.h"

/*
 * 预设结构 (定义于 config.cpp):
 *   OscParams { waveform(0-5), attack_ms, sustain, release_ms, volume(0-1),
 *               pitchMul, useFilter1, useFilter2 }
 *   FilterParams { fc(Hz), intensity(0-1) }
 *   Preset { OscParams osc1; OscParams osc2; FilterParams filter1; FilterParams filter2; }
 *
 * pitchMul: 频率倍数: 2.0, 1.5, 1.0, 0.666667f, 0.5
 * waveform: 0=sine, 1=tri, 2=pulse1/8, 3=pulse1/4, 4=pulse1/2, 5=saw
 */

#define PM2   2.0f
#define PM15  1.5f
#define PM1   1.0f
#define PM066 0.666667f
#define PM05  0.5f

const Preset presets[16] = {
    // ============================================================
    // 0: Grand Piano — 明亮钢琴
    // ============================================================
    {
        { WAVE_SINE, 10, true,  200, 0.80f, PM1,  false, true  },  // osc1
        { WAVE_TRI,  30, true,  400, 0.40f, PM1,  false, true  },  // osc2
        { 2000, 0.5f },   // filter1: HP, 轻微去低频
        { 8000, 0.35f }    // filter2: LP, 轻微柔化高频
    },

    // ============================================================
    // 1: Warm Strings — 温暖弦乐
    // ============================================================
    {
        { WAVE_SAW,  80, true,  500, 0.70f, PM1,  false, true  },
        { WAVE_SAW, 100, true,  600, 0.45f, PM1,  false, true  },
        { 150,  0.3f  },   // HP: 轻微去除次声频
        { 3500, 0.75f }    // LP: 大幅柔化
    },

    // ============================================================
    // 2: Synth Brass — 合成铜管
    // ============================================================
    {
        { WAVE_SAW,       25, true, 150, 0.85f, PM1,  false, true  },
        { WAVE_PULSE_1_2, 35, true, 200, 0.55f, PM1,  false, true  },
        { 200, 0.35f },
        { 5000, 0.45f }
    },

    // ============================================================
    // 3: Dream Pad — 梦幻铺底
    // ============================================================
    {
        { WAVE_SINE, 200, true, 900, 0.60f, PM1,  false, true  },
        { WAVE_TRI,  250, true, 800, 0.55f, PM05, false, true  },  // 低八度
        { 100, 0.4f  },
        { 1800, 0.85f }
    },

    // ============================================================
    // 4: Pluck Bass — 拨弦贝斯
    // ============================================================
    {
        { WAVE_TRI,        5, false, 120, 1.00f, PM1,  false, true },
        { WAVE_SAW,        8, false,  80, 0.25f, PM05, false, true }, // 低八度
        { 80,  0.3f },
        { 1200, 0.70f }
    },

    // ============================================================
    // 5: FM Bell — 调频钟铃
    // ============================================================
    {
        { WAVE_SINE,  2, false, 700, 0.80f, PM1,  true,  true  },
        { WAVE_SINE,  3, false, 500, 0.55f, PM2,  false, true  },  // 高八度泛音
        { 600,  0.50f },   // HP: 去低频, 突出金属感
        { 8000, 0.30f }
    },

    // ============================================================
    // 6: Pipe Organ — 管风琴
    // ============================================================
    {
        { WAVE_PULSE_1_2, 40, true, 60, 0.90f, PM1,  false, false },
        { WAVE_PULSE_1_4, 50, true, 50, 0.70f, PM1,  false, false },
        { 50,  0.1f  },   // 几乎不过滤
        { 20000, 0.05f }
    },

    // ============================================================
    // 7: Lead Saw — 主音锯齿
    // ============================================================
    {
        { WAVE_SAW,       15, true, 120, 0.90f, PM1,  false, true  },
        { WAVE_PULSE_1_8, 20, true, 100, 0.35f, PM1,  false, true  },
        { 120, 0.25f },
        { 4500, 0.55f }
    },

    // ============================================================
    // 8: Crystal — 水晶音色
    // ============================================================
    {
        { WAVE_SINE, 120, true, 1100, 0.70f, PM1,  false, true },
        { WAVE_TRI,  100, true, 1000, 0.60f, PM15, false, true },  // 五度泛音
        { 350, 0.40f },
        { 2800, 0.65f }
    },

    // ============================================================
    // 9: Clavinet — 克拉维琴
    // ============================================================
    {
        { WAVE_PULSE_1_8,  5, false,  90, 0.90f, PM1, false, true },
        { WAVE_PULSE_1_4,  5, false,  70, 0.45f, PM1, false, true },
        { 150, 0.15f },
        { 6500, 0.35f }
    },

    // ============================================================
    // 10: Deep Bass — 深低音
    // ============================================================
    {
        { WAVE_SAW,  8, true, 250, 1.00f, PM1,  false, true },
        { WAVE_SINE, 5, true, 200, 0.45f, PM05, false, true },  // 低八度
        { 40,  0.2f },
        { 700, 0.85f }
    },

    // ============================================================
    // 11: Harpsichord — 羽管键琴
    // ============================================================
    {
        { WAVE_PULSE_1_2,  3, false, 140, 0.80f, PM1, false, true },
        { WAVE_PULSE_1_8,  3, false, 100, 0.55f, PM2, false, true },  // 高八度
        { 100, 0.10f },
        { 7000, 0.25f }
    },

    // ============================================================
    // 12: Pan Flute — 排箫
    // ============================================================
    {
        { WAVE_SINE, 70, true, 350, 0.85f, PM1,  false, true  },
        { WAVE_SINE, 90, true, 400, 0.15f, PM1,  false, true  },
        { 250, 0.35f },    // HP: 去低频呼吸声
        { 3500, 0.55f }
    },

    // ============================================================
    // 13: Trumpet — 小号
    // ============================================================
    {
        { WAVE_SAW,       20, true, 130, 0.90f, PM1, false, true },
        { WAVE_PULSE_1_2, 25, true, 150, 0.50f, PM1, false, true },
        { 180, 0.35f },
        { 6500, 0.35f }
    },

    // ============================================================
    // 14: Vibraphone — 颤音琴
    // ============================================================
    {
        { WAVE_SINE,  5, true, 1800, 0.75f, PM1, false, true },
        { WAVE_TRI,   8, true, 1400, 0.40f, PM2, false, true },  // 高八度泛音
        { 80,  0.25f },
        { 5000, 0.45f }
    },

    // ============================================================
    // 15: Tutti Orchestra — 全奏乐团
    // ============================================================
    {
        { WAVE_SAW, 120, true, 550, 0.80f, PM1,  false, true },
        { WAVE_TRI, 150, true, 600, 0.55f, PM1,  false, true },
        { 80,  0.30f },
        { 4500, 0.55f }
    }
};
